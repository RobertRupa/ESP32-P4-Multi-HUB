## firmware/c6/main/Kconfig.projbuild
```kconfig
menu "HUB Zigbee coordinator"

config HUB_C6_ZIGBEE_COORD_ENABLE
    bool "Enable native Zigbee coordinator over ESP-Hosted SDIO"
    depends on IDF_TARGET_ESP32C6 && ESP_HOSTED_CP_FEAT_WIFI
    select ESP_HOSTED_CP_FEAT_PEER_DATA
    default n
    help
        Run the Zigbee coordinator on the C6 native 802.15.4 radio while
        keeping ESP-Hosted Wi-Fi on SDIO. Reports and commands use Peer Data
        RPC. Pairing stays closed until a confirmed P4 command.

endmenu
```

## firmware/c6/sdkconfig.defaults
```kconfig
CONFIG_ESP_HOSTED=y
CONFIG_ESP_HOSTED_CP=y
CONFIG_ESP_HOSTED_CP_FOR_MCU=y
CONFIG_ESP_HOSTED_CP_RPC_V2=y
CONFIG_ESP_HOSTED_CP_FEAT_WIFI=y
CONFIG_ESP_HOSTED_CP_FEAT_PEER_DATA=y
CONFIG_ESP_HOSTED_CP_FEAT_PEER_DATA_AUTO_INIT=y
CONFIG_ESP_WIFI_ENTERPRISE_SUPPORT=n
CONFIG_ESP_WIFI_NVS_ENABLED=y
CONFIG_FREERTOS_HZ=1000
```

## firmware/c6/sdkconfig.defaults.esp32c6
```kconfig
CONFIG_ESP_DEFAULT_CPU_FREQ_MHZ_160=y
CONFIG_HUB_C6_ZIGBEE_COORD_ENABLE=y
CONFIG_BT_ENABLED=n
CONFIG_BT_CONTROLLER_ONLY=y
CONFIG_BT_BLUEDROID_ENABLED=n
CONFIG_BT_LE_SLEEP_ENABLE=y
CONFIG_BT_LE_HCI_INTERFACE_USE_RAM=y
CONFIG_ESPTOOLPY_FLASHSIZE_4MB=y
CONFIG_PARTITION_TABLE_CUSTOM=y
CONFIG_PARTITION_TABLE_CUSTOM_FILENAME="partitions_eh_cp_ota_4m.csv"
CONFIG_ESP_CACHE_MALLOC=y
CONFIG_ESP_WIFI_STATIC_RX_BUFFER_NUM=20
CONFIG_ESP_WIFI_DYNAMIC_RX_BUFFER_NUM=64
CONFIG_ESP_WIFI_DYNAMIC_TX_BUFFER_NUM=64
CONFIG_ESP_WIFI_AMPDU_TX_ENABLED=y
CONFIG_ESP_WIFI_TX_BA_WIN=32
CONFIG_ESP_WIFI_AMPDU_RX_ENABLED=y
CONFIG_ESP_WIFI_RX_BA_WIN=32
CONFIG_ESP_WIFI_RX_IRAM_OPT=y
CONFIG_ESP_WIFI_IRAM_OPT=y
CONFIG_LWIP_TCP_LOCAL_PORT_RANGE_START=61440
CONFIG_LWIP_UDP_LOCAL_PORT_RANGE_START=61440
CONFIG_LWIP_TCP_SND_BUF_DEFAULT=65535
CONFIG_LWIP_TCP_RECVMBOX_SIZE=64
CONFIG_LWIP_TCPIP_RECVMBOX_SIZE=64
CONFIG_COMPILER_OPTIMIZATION_PERF=y
CONFIG_ESP_CONSOLE_NONE=y
CONFIG_ESP_COEX_SW_COEXIST_ENABLE=y
CONFIG_ZB_ENABLED=y
CONFIG_ZB_ZCZR=y
CONFIG_ZB_RADIO_NATIVE=y
# CONFIG_ZB_RADIO_SPINEL_UART is not set
```

## firmware/c6/sdkconfig.defaults.multipan
```kconfig
CONFIG_HUB_MULTIPAN_RCP_ENABLE=y
CONFIG_ESP_CONSOLE_NONE=y
CONFIG_ESP_COEX_SW_COEXIST_ENABLE=y
CONFIG_OPENTHREAD_ENABLED=y
CONFIG_OPENTHREAD_RADIO=y
CONFIG_OPENTHREAD_RCP_UART=y
CONFIG_OPENTHREAD_CLI=n
CONFIG_OPENTHREAD_LOG_LEVEL_DYNAMIC=n
CONFIG_OPENTHREAD_LOG_LEVEL_NONE=y
CONFIG_OPENTHREAD_BORDER_ROUTER=n
CONFIG_OPENTHREAD_MULTIPAN_RCP_ENABLE=y
CONFIG_OPENTHREAD_MULTIPLE_INTERFACES_COUNT=2
CONFIG_IEEE802154_MULTI_PAN_ENABLE=y
```

## firmware/c6/sdkconfig.defaults.zigbee-sdio
```kconfig
CONFIG_HUB_C6_ZIGBEE_COORD_ENABLE=y
CONFIG_ESP_CONSOLE_NONE=y
CONFIG_ESP_COEX_SW_COEXIST_ENABLE=y
CONFIG_ESP_HOSTED_CP_FEAT_WIFI=y
CONFIG_ESP_HOSTED_CP_FEAT_PEER_DATA=y
CONFIG_ESP_HOSTED_CP_FEAT_PEER_DATA_AUTO_INIT=y
CONFIG_ZB_ENABLED=y
CONFIG_ZB_ZCZR=y
CONFIG_ZB_RADIO_NATIVE=y
CONFIG_ZB_RADIO_SPINEL_UART=n
```

## firmware/h2/main/Kconfig.projbuild
```kconfig
menu "HUB H2 UART diagnostic"

config HUB_H2_UART_DIAGNOSTIC_ENABLE
    bool "Use temporary UART ping/ACK diagnostic startup"
    depends on IDF_TARGET_ESP32H2
    default n
    help
        Bypass the normal OpenThread RCP startup and exercise UART0 only.

endmenu
```

## firmware/h2/sdkconfig.defaults
```kconfig
CONFIG_PARTITION_TABLE_CUSTOM=y
CONFIG_PARTITION_TABLE_CUSTOM_FILENAME="partitions.csv"
CONFIG_PARTITION_TABLE_OFFSET=0x8000
CONFIG_PARTITION_TABLE_MD5=y

CONFIG_OPENTHREAD_ENABLED=y
CONFIG_OPENTHREAD_RADIO=y
CONFIG_OPENTHREAD_RADIO_NATIVE=y
CONFIG_OPENTHREAD_RCP_UART=y
CONFIG_OPENTHREAD_NCP_VENDOR_HOOK=y
CONFIG_OPENTHREAD_CONSOLE_ENABLE=n
CONFIG_OPENTHREAD_CLI=n
CONFIG_OPENTHREAD_BORDER_ROUTER=n
CONFIG_OPENTHREAD_COMMISSIONER=n
CONFIG_OPENTHREAD_JOINER=n
CONFIG_OPENTHREAD_TASK_SIZE=3072
CONFIG_OPENTHREAD_RCP_SPINEL_CONSOLE=n
CONFIG_OPENTHREAD_LOG_LEVEL_DYNAMIC=n
CONFIG_OPENTHREAD_LOG_LEVEL_NONE=y

CONFIG_ESP_COEX_SW_COEXIST_ENABLE=n
CONFIG_FREERTOS_HZ=1000
CONFIG_ESP_CONSOLE_USB_SERIAL_JTAG=y
CONFIG_ESP_CONSOLE_SECONDARY_NONE=y
CONFIG_LOG_DEFAULT_LEVEL_INFO=y
```

## firmware/p4/main/Kconfig.projbuild
```kconfig
menu "HUB Web security"
config HUB_WEB_DEVELOPMENT_MODE
    bool "Use development Web UI credentials"
    default n
    help
        Use the fixed admin/admin Web UI credential and fewer PBKDF2 iterations.
        This must remain disabled for production firmware.
    endmenu

    menu "HUB UART diagnostic"

    config HUB_UART_DIAGNOSTIC_ENABLE
        bool "Use temporary raw UART diagnostic startup"
        depends on IDF_TARGET_ESP32P4
        default n
        help
            Bypass normal P4 services and run the bounded H2 UART ping/ACK test.

    config HUB_UART_DIAGNOSTIC_PORT
        int "UART port connected to H2"
        depends on HUB_UART_DIAGNOSTIC_ENABLE
        range 0 2
        default 1

    config HUB_UART_DIAGNOSTIC_TX_GPIO
        int "P4 UART TX GPIO to H2 RX"
        depends on HUB_UART_DIAGNOSTIC_ENABLE
        range -1 SOC_GPIO_OUT_RANGE_MAX
        default 26

    config HUB_UART_DIAGNOSTIC_RX_GPIO
        int "P4 UART RX GPIO from H2 TX"
        depends on HUB_UART_DIAGNOSTIC_ENABLE
        range -1 SOC_GPIO_IN_RANGE_MAX
        default 27

    endmenu

    menu "HUB multipan radio"

config HUB_MULTIPAN_ENABLE
    bool "Enable Zigbee + Thread multipan coordinator"
    depends on IDF_TARGET_ESP32P4
    default n
    help
        Starts the P4 multipan host with an external 802.15.4 RCP. Keep disabled
        until the UART link and shared RS485 nets are verified on the board.

config HUB_MULTIPAN_UART_PORT
    int "UART port to multipan RCP"
    depends on HUB_MULTIPAN_ENABLE
    range 0 2
    default 1

config HUB_MULTIPAN_UART_TX_GPIO
    int "P4 UART TX GPIO to RCP RX"
    depends on HUB_MULTIPAN_ENABLE
    range -1 SOC_GPIO_OUT_RANGE_MAX
    default -1

config HUB_MULTIPAN_UART_RX_GPIO
    int "P4 UART RX GPIO from RCP TX"
    depends on HUB_MULTIPAN_ENABLE
    range -1 SOC_GPIO_IN_RANGE_MAX
    default -1

endmenu

    menu "HUB Zigbee RCP coordinator"

config HUB_H2_ZIGBEE_RCP_ENABLE
    bool "Host Zigbee coordinator on P4 with an external H2 RCP"
    depends on IDF_TARGET_ESP32P4 && !HUB_MULTIPAN_ENABLE && !SOC_IEEE802154_SUPPORTED
    select ZB_ENABLED
    default n
    help
        Build the P4-hosted Zigbee coordinator using a dedicated H2 radio over
        UART Spinel. Keep disabled until the matching H2 RCP and UART wiring
        have been verified and the host/RCP handshake has passed.

config HUB_H2_ZIGBEE_UART_PORT
    int "UART port to H2 Zigbee RCP"
    depends on HUB_H2_ZIGBEE_RCP_ENABLE
    range 0 2
    default 1

config HUB_H2_ZIGBEE_UART_TX_GPIO
    int "P4 UART TX GPIO to H2 RCP RX"
    depends on HUB_H2_ZIGBEE_RCP_ENABLE
    range -1 SOC_GPIO_OUT_RANGE_MAX
    default -1

config HUB_H2_ZIGBEE_UART_RX_GPIO
    int "P4 UART RX GPIO from H2 RCP TX"
    depends on HUB_H2_ZIGBEE_RCP_ENABLE
    range -1 SOC_GPIO_IN_RANGE_MAX
    default -1

    endmenu
```

## firmware/p4/sdkconfig.defaults
```kconfig
CONFIG_ESP_HOSTED=y
CONFIG_ESP_HOSTED_HOST=y
CONFIG_ESP_HOSTED_HOST_FEAT_RPC=y
CONFIG_ESP_HOSTED_HOST_FEAT_RPC_EXT_V2=y
CONFIG_ESP_HOSTED_HOST_FEAT_SYSTEM=y
CONFIG_ESP_HOSTED_HOST_FEAT_WIFI=y
CONFIG_ESP_HOSTED_HOST_FEAT_PEER_DATA=y
CONFIG_ESP_HOSTED_HOST_FEAT_PEER_DATA_AUTO_INIT=y
CONFIG_ESP_HOSTED_HOST_TRANSPORT_BUS_SDIO=y
CONFIG_FREERTOS_HZ=1000
CONFIG_ESP_HTTPS_SERVER_ENABLE=y
CONFIG_MBEDTLS_TLS_SERVER=y
CONFIG_MBEDTLS_PEM_WRITE_C=y
CONFIG_MBEDTLS_ECP_C=y
CONFIG_MBEDTLS_ECDSA_C=y
```

## firmware/p4/sdkconfig.defaults.esp32p4
```kconfig
CONFIG_SLAVE_IDF_TARGET_ESP32C6=y
CONFIG_ESPTOOLPY_FLASHSIZE_16MB=y
CONFIG_SPI_FLASH_SUPPORT_BOYA_CHIP=y
CONFIG_PARTITION_TABLE_CUSTOM=y
CONFIG_PARTITION_TABLE_CUSTOM_FILENAME="partitions_hub_p4_c6_ota.csv"
CONFIG_PARTITION_TABLE_OFFSET=0x11000
CONFIG_ESP_CONSOLE_USB_SERIAL_JTAG=y
CONFIG_ESP_HOSTED_SDIO_SLOT_1=y
CONFIG_ESP_HOSTED_HOST_SDIO_BUS_WIDTH_4=y
CONFIG_ESP_HOSTED_HOST_SDIO_CLK_KHZ=5000
CONFIG_ESP_HOSTED_HOST_SDIO_PIN_CLK=18
CONFIG_ESP_HOSTED_HOST_SDIO_PIN_CMD=19
CONFIG_ESP_HOSTED_HOST_SDIO_PIN_D0=14
CONFIG_ESP_HOSTED_HOST_SDIO_PIN_D1=15
CONFIG_ESP_HOSTED_HOST_SDIO_PIN_D2=16
CONFIG_ESP_HOSTED_HOST_SDIO_PIN_D3=17
CONFIG_ESP_HOSTED_HOST_RESET_GPIO=54
CONFIG_ESP_HOSTED_HOST_FEAT_WIFI=y
CONFIG_ESP_HOSTED_HOST_FEAT_PEER_DATA=y
CONFIG_ESP_HOSTED_HOST_FEAT_PEER_DATA_AUTO_INIT=y
CONFIG_SPIRAM=y
CONFIG_SPIRAM_MODE_HEX=y
CONFIG_SPIRAM_SPEED_200M=y
CONFIG_LV_FONT_MONTSERRAT_16=y
CONFIG_LV_FONT_MONTSERRAT_24=y
CONFIG_SECURE_FLASH_ENC_ENABLED=y
CONFIG_SECURE_FLASH_ENCRYPTION_MODE_DEVELOPMENT=y
CONFIG_NVS_ENCRYPTION=n
CONFIG_NVS_SEC_HMAC_EFUSE_KEY_ID=1
```

## firmware/p4/sdkconfig.defaults.h2-jc4880p443c
```kconfig
CONFIG_HUB_H2_ZIGBEE_RCP_ENABLE=y
CONFIG_HUB_H2_ZIGBEE_UART_PORT=1
CONFIG_HUB_H2_ZIGBEE_UART_TX_GPIO=26
CONFIG_HUB_H2_ZIGBEE_UART_RX_GPIO=27
CONFIG_HUB_WEB_DEVELOPMENT_MODE=y
```

## firmware/p4/sdkconfig.defaults.h2-zigbee
```kconfig
CONFIG_HUB_H2_ZIGBEE_RCP_ENABLE=y
CONFIG_ESP_MAIN_TASK_STACK_SIZE=8192
CONFIG_ZB_ENABLED=y
CONFIG_ZB_ZCZR=y
CONFIG_ZB_RADIO_SPINEL_UART=y
```

## firmware/p4/sdkconfig.defaults.multipan
```kconfig
CONFIG_HUB_MULTIPAN_ENABLE=y

CONFIG_ESP_HOSTED=y
CONFIG_ESP_HOSTED_AUTO_CALL_INIT_BEFORE_APP_MAIN=y
CONFIG_ESP_HOSTED_HOST_FEAT_RPC=y
CONFIG_ESP_HOSTED_HOST_FEAT_RPC_EXT_V2=y
CONFIG_ESP_HOSTED_HOST_FEAT_SYSTEM=y
CONFIG_ESP_HOSTED_HOST_FEAT_WIFI=y

CONFIG_OPENTHREAD_ENABLED=y
CONFIG_OPENTHREAD_BORDER_ROUTER=y
CONFIG_OPENTHREAD_RADIO_SPINEL_UART=y
CONFIG_OPENTHREAD_MULTIPAN_HOST_ENABLE=y
CONFIG_OPENTHREAD_MULTIPLE_INTERFACES_COUNT=2
CONFIG_OPENTHREAD_RX_ON_WHEN_IDLE=n
CONFIG_OPENTHREAD_TASK_SIZE=10240

CONFIG_ZB_ENABLED=y
CONFIG_ZB_ZCZR=y
CONFIG_ZB_RADIO_SPINEL_UART=y

CONFIG_MBEDTLS_SSL_PROTO_DTLS=y
CONFIG_MBEDTLS_SSL_DTLS_CONNECTION_ID=y
CONFIG_MBEDTLS_KEY_EXCHANGE_ECJPAKE=y
CONFIG_MBEDTLS_ECJPAKE_C=y

CONFIG_LWIP_IPV6_NUM_ADDRESSES=12
CONFIG_LWIP_IPV6_AUTOCONFIG=y
CONFIG_LWIP_HOOK_IP6_ROUTE_DEFAULT=y
CONFIG_LWIP_HOOK_ND6_GET_GW_DEFAULT=y
CONFIG_LWIP_HOOK_IP6_INPUT_CUSTOM=y
CONFIG_LWIP_HOOK_IP6_SELECT_SRC_ADDR_CUSTOM=y
CONFIG_LWIP_MULTICAST_PING=y
CONFIG_LWIP_NETIF_STATUS_CALLBACK=y
```

## firmware/p4/sdkconfig.defaults.uart-diagnostic
```kconfig
CONFIG_HUB_UART_DIAGNOSTIC_ENABLE=y
CONFIG_HUB_UART_DIAGNOSTIC_PORT=1
CONFIG_HUB_UART_DIAGNOSTIC_TX_GPIO=26
CONFIG_HUB_UART_DIAGNOSTIC_RX_GPIO=27
```
